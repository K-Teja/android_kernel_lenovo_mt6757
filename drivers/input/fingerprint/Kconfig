## drivers/input/fingerprint/Kconfig
```kconfig
#
#Fingerprint
#
menu "Fingerprint support"
	depends on INPUT

config MTK_FINGERPRINT_SUPPORT
	bool "Mediatek Fingerprint"
	default n
	---help---
	Fingerprint mtk driver enable/disable in the kernel.
	Say Y here if you want to use mediatek fingerprint driver,
	fingerprint driver will support fingerprint function


if MTK_FINGERPRINT_SELECT = "GF3208"
config GOODIX_FINGERPRINT_GF3208
	bool "Goodix Fingerprint"
	default n
	---help---
	LC goodix fp.
endif
endmenu
```
